## config/boards/shields/charybdis/Kconfig.defconfig
```kconfig
if SHIELD_CHARYBDIS_RIGHT

config ZMK_KEYBOARD_NAME
	default "Charybdis"

config ZMK_SPLIT_BLE_ROLE_CENTRAL
	bool
	default y

endif


if SHIELD_CHARYBDIS_LEFT

config ZMK_SPLIT_BLE_ROLE_PERIPHERAL
	bool
	default y

endif


if SHIELD_CHARYBDIS_LEFT || SHIELD_CHARYBDIS_RIGHT

config ZMK_SPLIT
	bool
	default y

endif
```
